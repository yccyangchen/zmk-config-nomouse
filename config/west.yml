## config/west.yml
```yaml
manifest:
  remotes:
    - name: zmkfirmware
      url-base: https://github.com/zmkfirmware
    - name: main
      url-base: https://github.com/lucordes
  projects:
    - name: zmk
      remote: main
      revision: main
      import: app/west.yml
  self:
    path: config
```
